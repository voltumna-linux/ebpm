## conf/layer.conf
```bitbake
# We have a conf and classes directory, add to BBPATH
BBPATH .= ":${LAYERDIR}"

# We have recipes-* directories, add to BBFILES
BBFILES += "${LAYERDIR}/recipes-*/*/*.bb \
	    ${LAYERDIR}/recipes-*/*/*.bbappend"

BBFILE_COLLECTIONS += "ebpm"
BBFILE_PATTERN_ebpm = "^${LAYERDIR}/"
BBFILE_PRIORITY_ebpm = "11"

LAYERSERIES_COMPAT_ebpm = "kirkstone"

# This should only be incremented on significant changes that will
# cause compatibility issues with other layers
LAYERVERSION_ebpm = "1"

LAYERDEPENDS_ebpm = "core"
```
